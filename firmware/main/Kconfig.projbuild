## firmware/main/Kconfig.projbuild
```kconfig
menu "Tempest Weather Display"

    config TEMPEST_NETWORK_ENABLED
        bool "Enable networking (Wi-Fi, forecast, OTA)"
        default y
        help
            Turn this OFF to build a display-only image with all networking
            compiled out.

            Needed while the ESP32-C6 co-processor is not usable: when
            ESP-Hosted cannot read the slave's registers it deliberately
            restarts the P4 ("Host is reseting itself"), which reboots the
            board every ~15 seconds and makes the panel flash continuously.
            There is no runtime way to stop that, so it has to be a build
            option.

            With this off the panel renders and touch works; there is simply
            no weather data.

    config TEMPEST_WIFI_SSID
        string "Wi-Fi SSID"
        default ""

    config TEMPEST_WIFI_PASSWORD
        string "Wi-Fi password"
        default ""

    config TEMPEST_STATION_ID
        int "Tempest station ID"
        default 230728
        help
            Used for the REST forecast poll. Find it in the tempestwx.com URL.

    config TEMPEST_UDP_PORT
        int "Tempest hub UDP broadcast port"
        default 50222
        help
            The hub broadcasts unauthenticated JSON here. Do not change unless
            WeatherFlow does.

    config TEMPEST_FORECAST_INTERVAL_S
        int "Forecast poll interval (seconds)"
        default 600
        help
            Live values come from UDP, so there is no reason to poll fast.
            WeatherFlow publishes no rate limit; 10 minutes is a courtesy budget.

    config TEMPEST_OBS_STALE_S
        int "Observation staleness threshold (seconds)"
        default 180
        help
            obs_st arrives every 60 s. If none has arrived for this long the UI
            marks the reading degraded.

    config INDOOR_POLL_INTERVAL_S
        int "Indoor sensor poll interval (seconds)"
        default 30
        help
            Indoor temperature moves slowly. 30 s is already generous.

    config INDOOR_STALE_S
        int "Indoor staleness threshold (seconds)"
        default 1800
        help
            Past this age the indoor gauge dims and shows how old the reading
            is. A sensor that has been unplugged should look obviously wrong
            rather than quietly frozen.

    config OTA_ENABLED
        bool "Enable over-the-air updates"
        default y
        help
            Serves a firmware upload page on port 80. Worth having on a panel
            that is going to live on a wall.

    config OTA_PASSWORD
        string "OTA shared secret (X-OTA-Password header)"
        default ""
        depends on OTA_ENABLED
        help
            Required in the X-OTA-Password header for uploads. LEAVING THIS
            EMPTY means anyone who can reach the device on your network can
            reflash it. There is no TLS either way -- this is a LAN-only
            convenience, not a security boundary.

    config DIAG_ON_BOOT
        bool "Run bring-up diagnostics at boot"
        default y
        help
            Logs chip info, partition layout, reset reason and an I2C bus scan
            before the display initialises. Keep this on until board_pins.h is
            verified against real hardware.

endmenu
```
